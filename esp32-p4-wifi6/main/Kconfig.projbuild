## esp32-p4-wifi6/main/Kconfig.projbuild
```kconfig
menu "P4 Voice Client Configuration"

    config P4_WIFI_SSID
        string "WiFi SSID"
        default "myssid"
        help
            SSID (network name) to connect to. The radio runs on the
            on-board ESP32-C6 (WiFi 6) via esp-hosted.

    config P4_WIFI_PASSWORD
        string "WiFi Password"
        default "mypassword"
        help
            WiFi password (WPA or WPA2).

    config P4_BACKEND_URL
        string "Backend /api/transcribe URL"
        default "http://192.168.1.100/api/transcribe"
        help
            Full URL of the backend's transcription endpoint. The firmware
            strips the "/api/transcribe" suffix to get the backend's base
            URL, then also calls <base>/api/llm-command and
            <base>/api/ha-execute on it to run the full voice pipeline (all
            three must be reachable at the same host/port). When the
            backend runs via docker-compose it is reached through the
            frontend's nginx on port 80 (proxied to backend:3001), so use
            http://<host-ip>/api/transcribe (no :3001). Point it at your
            Docker host's LAN IP.

    config P4_RECORD_SECONDS
        int "Recording duration after wake word (seconds)"
        range 1 10
        default 4
        help
            How long to record and send audio after the wake word is detected.

    config P4_I2C_SDA_GPIO
        int "ES8311 I2C SDA GPIO"
        default 7

    config P4_I2C_SCL_GPIO
        int "ES8311 I2C SCL GPIO"
        default 8

    config P4_I2S_MCLK_GPIO
        int "I2S MCLK GPIO"
        default 13

    config P4_I2S_BCLK_GPIO
        int "I2S BCLK (SCLK) GPIO"
        default 12

    config P4_I2S_WS_GPIO
        int "I2S WS (LRCLK) GPIO"
        default 10

    config P4_I2S_DIN_GPIO
        int "I2S DIN (mic data from ES8311 ASDOUT) GPIO"
        default 11

    config P4_I2S_DOUT_GPIO
        int "I2S DOUT (speaker data to ES8311 DSDIN) GPIO, -1 to disable playback"
        default 9
        help
            GPIO driving the ES8311's DSDIN (speaker/DAC data in) pin, used
            to play the TTS response through the onboard speaker. Not in
            Waveshare's public specs; derived from the schematic of the
            ESP32-P4-WIFI6-Touch-LCD-XC variant, which reuses the same
            ESP32-P4-WIFI6-M core module (its MCLK/SCLK/LRCK/ASDOUT net
            labels there - GPIO13/12/10/11 - match this project's
            already-verified-working pin assignments exactly, which is why
            9 is trusted here too). Not verified on real hardware yet -
            if speaker output stays silent or misbehaves, double check
            against your own board's schematic. Set to -1 to disable
            playback entirely (falls back to pre-speaker-support behavior).

    config P4_PA_ENABLE_GPIO
        int "Speaker amplifier (NS4150B) enable GPIO, -1 if always-on"
        default 53
        help
            Drives the NS4150B amplifier's CTRL pin (through series
            resistor R105 per the schematic referenced above). Same
            provenance/confidence caveat as P4_I2S_DOUT_GPIO - not yet
            confirmed on real hardware. If the speaker stays silent even
            though DSDIN/DOUT looks right, try -1 first (some board
            revisions tie CTRL permanently high instead).

    config P4_SPEAKER_VOLUME
        int "Speaker output volume (0-100)"
        range 0 100
        default 70

    config P4_MIC_GAIN_DB
        int "Microphone input gain (dB)"
        range 0 50
        default 40
        help
            Analog PGA gain on the ES8311's mic input. Raised from the
            board's nominal 30 dB default: logged peak amplitudes during
            normal speech topped out around 1200 (of a possible 32767) at
            30 dB, leaving WakeNet a weak signal to work with at
            conversational volume/distance. Push higher (up to 50) if wake
            word detection is still missed from across the room; back off
            if quiet-room false wakeups become a problem or the signal
            clips (peaks pinned at 32767).

endmenu
```

## esp32-p4-wifi6/sdkconfig.defaults
```kconfig
# Waveshare ESP32-P4-WIFI6 (ESP32-P4 + on-board ESP32-C6 for WiFi 6).
#
# WiFi is not native to the P4: it is provided by the ESP32-C6 co-processor
# over the esp-hosted (SDIO) link. Adding the esp_wifi_remote / esp_hosted
# components (see main/idf_component.yml) makes the normal esp_wifi API in
# wifi.c transparently talk to the C6, so no extra config is needed here
# beyond selecting the P4 target (`idf.py set-target esp32p4`).

# The Waveshare board's ESP32-P4 module carries 32MB hex-mode PSRAM. If
# your revision boots with a PSRAM init error, try SPIRAM_MODE_QUAD instead.
CONFIG_SPIRAM=y
CONFIG_SPIRAM_MODE_HEX=y
CONFIG_SPIRAM_SPEED_200M=y
CONFIG_SPIRAM_USE_MALLOC=y
# Required for esp_wifi_remote (v1.6.2, IDF 5.3.2 tag): its injected
# esp_wifi.h references CONFIG_WIFI_RMT_CACHE_TX_BUFFER_NUM whenever
# CONFIG_SPIRAM is set, but that Kconfig symbol itself is only defined
# when this option is on. Without it the build fails with "undeclared".
CONFIG_SPIRAM_TRY_ALLOCATE_WIFI_LWIP=y

# esp_hosted's SDIO transport tasks default to stacks in internal RAM/TCM,
# which on this board crashes at boot with:
#   assert failed: xTaskCreateStaticPinnedToCore ... xPortcheckValidStackMem
# (see github.com/espressif/esp-hosted-mcu issues on ESP32-P4 SDIO). Moving
# hosted's own task stacks to SPIRAM avoids it; CONFIG_SPIRAM_ALLOW_STACK_-
# EXTERNAL_MEMORY (default y here) is what makes PSRAM-backed stacks valid.
CONFIG_ESP_HOSTED_DFLT_TASK_FROM_SPIRAM=y

CONFIG_ESPTOOLPY_FLASHSIZE_16MB=y

CONFIG_PARTITION_TABLE_CUSTOM=y
CONFIG_PARTITION_TABLE_CUSTOM_FILENAME="partitions.csv"

CONFIG_FREERTOS_HZ=1000
CONFIG_ESP_MAIN_TASK_STACK_SIZE=8192

# Wake word model: "Hi, ESP". Pick a different CONFIG_SR_WN_* option via
# `idf.py menuconfig` -> ESP Speech Recognition -> Wake Word Engine for
# other phrases (Alexa, Jarvis, ...). The model is packed into
# build/srmodels/srmodels.bin and flashed to the `model` partition.
CONFIG_SR_WN_WN9_HIESP=y
CONFIG_SR_MN_CN_NONE=y
```
